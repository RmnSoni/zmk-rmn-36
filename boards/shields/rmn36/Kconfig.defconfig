## boards/shields/rmn36/Kconfig.defconfig
```kconfig
# Copyright (c) 2025 The ZMK Contributors
# SPDX-License-Identifier: MIT

if SHIELD_RMN36

config ZMK_KEYBOARD_NAME
	default "RMN36"

endif
```

## boards/shields/rmn36/Kconfig.shield
```kconfig
# Copyright (c) 2025 The ZMK Contributors
# SPDX-License-Identifier: MIT

config SHIELD_RMN36
	def_bool $(shields_list_contains,rmn36)
```
